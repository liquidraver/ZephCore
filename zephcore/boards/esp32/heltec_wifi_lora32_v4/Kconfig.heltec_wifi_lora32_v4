## zephcore/boards/esp32/heltec_wifi_lora32_v4/Kconfig.heltec_wifi_lora32_v4
```kconfig
config BOARD_HELTEC_WIFI_LORA32_V4
	select SOC_ESP32S3_WROOM_N16R2
	select SOC_ESP32S3_PROCPU if BOARD_HELTEC_WIFI_LORA32_V4_ESP32S3_PROCPU
```

## zephcore/boards/esp32/heltec_wifi_lora32_v4/board.yml
```yaml
board:
  name: heltec_wifi_lora32_v4
  full_name: Heltec WiFi LoRa 32 V4
  vendor: heltec
  socs:
    - name: esp32s3
```

## zephcore/boards/esp32/heltec_wifi_lora32_v43/Kconfig.heltec_wifi_lora32_v43
```kconfig
config BOARD_HELTEC_WIFI_LORA32_V43
	select SOC_ESP32S3_WROOM_N16R2
	select SOC_ESP32S3_PROCPU if BOARD_HELTEC_WIFI_LORA32_V43_ESP32S3_PROCPU
```

## zephcore/boards/esp32/heltec_wifi_lora32_v43/board.yml
```yaml
board:
  name: heltec_wifi_lora32_v43
  full_name: Heltec WiFi LoRa 32 V4.3
  vendor: heltec
  socs:
    - name: esp32s3
```

## zephcore/boards/esp32/heltec_wifi_lora32_v43/heltec_wifi_lora32_v43_procpu_defconfig
```kconfig
# Heltec WiFi LoRa 32 V4.3 — minimal Zephyr defconfig (procpu)
CONFIG_CONSOLE=y
CONFIG_SERIAL=y
CONFIG_UART_CONSOLE=y
CONFIG_GPIO=y
CONFIG_CLOCK_CONTROL=y
CONFIG_PINCTRL=y
CONFIG_SPI=y
CONFIG_I2C=y
CONFIG_FLASH=y
CONFIG_FLASH_MAP=y
CONFIG_NVS=y
```

## zephcore/boards/esp32/heltec_wireless_tracker_v2/Kconfig.heltec_wireless_tracker_v2
```kconfig
config BOARD_HELTEC_WIRELESS_TRACKER_V2
	select SOC_ESP32S3_FN8
	select SOC_ESP32S3_PROCPU if BOARD_HELTEC_WIRELESS_TRACKER_V2_ESP32S3_PROCPU
```

## zephcore/boards/esp32/heltec_wireless_tracker_v2/board.yml
```yaml
board:
  name: heltec_wireless_tracker_v2
  full_name: Heltec Wireless Tracker V2
  vendor: heltec
  socs:
    - name: esp32s3
```

## zephcore/boards/esp32/heltec_wireless_tracker_v2/heltec_wireless_tracker_v2_procpu_defconfig
```kconfig
# Heltec Wireless Tracker V2 — minimal Zephyr defconfig (procpu)
CONFIG_CLOCK_CONTROL=y
CONFIG_CONSOLE=y
CONFIG_SERIAL=y
CONFIG_UART_CONSOLE=y
CONFIG_GPIO=y
CONFIG_UART_INTERRUPT_DRIVEN=y
CONFIG_PINCTRL=y
CONFIG_SPI=y
CONFIG_I2C=y
CONFIG_FLASH=y
CONFIG_FLASH_MAP=y
CONFIG_NVS=y
```

## zephcore/boards/esp32/lilygo_tlora_c6/Kconfig.lilygo_tlora_c6
```kconfig
# LilyGo T-LoRa C6 board configuration

# SPDX-License-Identifier: MIT

config BOARD_LILYGO_TLORA_C6
	select SOC_ESP32_C6_WROOM_1U_N4
	select SOC_ESP32C6_HPCORE if BOARD_LILYGO_TLORA_C6_ESP32C6_HPCORE
```

## zephcore/boards/esp32/lilygo_tlora_c6/board.yml
```yaml
board:
  name: lilygo_tlora_c6
  full_name: LilyGo T-LoRa C6
  vendor: lilygo
  socs:
    - name: esp32c6
```

## zephcore/boards/esp32/station_g2/Kconfig.station_g2
```kconfig
config BOARD_STATION_G2
	select SOC_ESP32S3_WROOM_N16R8
	select SOC_ESP32S3_PROCPU if BOARD_STATION_G2_ESP32S3_PROCPU
```

## zephcore/boards/esp32/station_g2/board.yml
```yaml
board:
  name: station_g2
  full_name: BQ Station G2
  vendor: bq
  socs:
    - name: esp32s3
```

## zephcore/boards/nrf52840/gat562_30s/Kconfig.gat562_30s
```kconfig
# GAT562 30S Mesh Kit board selection
# SPDX-License-Identifier: MIT

config BOARD_GAT562_30S
	select SOC_NRF52840_QIAA
	select ZEPHCORE_UI_JOYSTICK	# 5-way joystick -> full companion menu UI
```

## zephcore/boards/nrf52840/gat562_30s/board.yml
```yaml
board:
  name: gat562_30s
  full_name: GAT562 30S Mesh Kit (nRF52840 + SX1262, 30dBm/1W)
  vendor: gat
  socs:
    - name: nrf52840
```

## zephcore/boards/nrf52840/gat562_30s/gat562_30s_defconfig
```kconfig
# SPDX-License-Identifier: MIT
# GAT562 30S Mesh Kit default configuration
# (most subsystems also come from zephcore_common.conf + nrf52_common.conf;
#  these are the board essentials, kept self-contained like other custom boards)

# MPU + hardware stack protection
CONFIG_ARM_MPU=y
CONFIG_HW_STACK_PROTECTION=y

# GPIO + pin control
CONFIG_GPIO=y
CONFIG_PINCTRL=y

# Console over USB CDC-ACM (DT node + nrf52_common.conf USB stack)
CONFIG_CONSOLE=y
CONFIG_UART_CONSOLE=y
CONFIG_SERIAL=y
CONFIG_UART_LINE_CTRL=y

# Flash / NVS (LittleFS app data partition)
CONFIG_FLASH=y
CONFIG_FLASH_MAP=y
CONFIG_NVS=y

# SPI for LoRa, ADC for battery sense
CONFIG_SPI=y
CONFIG_ADC=y

# SEGGER RTT (matches the RAK4631 base this board derives from)
CONFIG_USE_SEGGER_RTT=y
```

## zephcore/boards/nrf52840/heltec_t096/Kconfig.heltec_t096
```kconfig
# Copyright (c) 2026 ZephCore
#
# SPDX-License-Identifier: MIT

config BOARD_HELTEC_T096
	select SOC_NRF52840_QIAA
```

## zephcore/boards/nrf52840/heltec_t096/board.yml
```yaml
# Copyright (c) 2026 ZephCore
#
# SPDX-License-Identifier: MIT

board:
  name: heltec_t096
  full_name: Heltec Mesh Node T096
  vendor: heltec
  socs:
  - name: nrf52840
```

## zephcore/boards/nrf52840/heltec_t114/Kconfig.heltec_t114
```kconfig
# Copyright (c) 2026 ZephCore
#
# SPDX-License-Identifier: MIT

config BOARD_HELTEC_T114
	select SOC_NRF52840_QIAA
```

## zephcore/boards/nrf52840/heltec_t114/board.yml
```yaml
# Copyright (c) 2026 ZephCore
#
# SPDX-License-Identifier: MIT

board:
  name: heltec_t114
  full_name: Heltec T114
  vendor: heltec
  socs:
  - name: nrf52840
```

## zephcore/boards/nrf52840/ikoka_nano_30dbm/Kconfig.ikoka_nano_30dbm
```kconfig
# Ikoka Nano 30dBm board configuration
# DC/DC converter enabled via DTS: &reg1 { regulator-initial-mode = <NRF5X_REG_MODE_DCDC>; }

config BOARD_IKOKA_NANO_30DBM
	select SOC_NRF52840_QIAA
```

## zephcore/boards/nrf52840/ikoka_nano_30dbm/board.yml
```yaml
board:
  name: ikoka_nano_30dbm
  full_name: Ikoka Nano 30dBm (XIAO nRF52840 + E22-900M30S)
  vendor: ikoka
  socs:
    - name: nrf52840
```

## zephcore/boards/nrf52840/ikoka_stick_22dbm/Kconfig.ikoka_stick_22dbm
```kconfig
# Ikoka Stick 22dBm board configuration
# DC/DC converter enabled via DTS: &reg1 { regulator-initial-mode = <NRF5X_REG_MODE_DCDC>; }

config BOARD_IKOKA_STICK_22DBM
	select SOC_NRF52840_QIAA
```

## zephcore/boards/nrf52840/ikoka_stick_22dbm/board.yml
```yaml
board:
  name: ikoka_stick_22dbm
  full_name: Ikoka Stick 22dBm (XIAO nRF52840 + E22-900M22S)
  vendor: ikoka
  socs:
    - name: nrf52840
```

## zephcore/boards/nrf52840/ikoka_stick_22dbm/ikoka_stick_22dbm_defconfig
```kconfig
# SPDX-License-Identifier: Apache-2.0
# Ikoka Stick 22dBm default configuration

# Enable MPU
CONFIG_ARM_MPU=y
CONFIG_HW_STACK_PROTECTION=y

# Enable GPIO
CONFIG_GPIO=y

# Enable console on USB CDC (new stack)
CONFIG_CONSOLE=y
CONFIG_UART_CONSOLE=y
CONFIG_SERIAL=y
CONFIG_UART_LINE_CTRL=y

# Enable flash/NVS storage
CONFIG_FLASH=y
CONFIG_FLASH_MAP=y
CONFIG_NVS=y

# Pinctrl
CONFIG_PINCTRL=y

# SPI for LoRa
CONFIG_SPI=y

# ADC for battery
CONFIG_ADC=y
```
