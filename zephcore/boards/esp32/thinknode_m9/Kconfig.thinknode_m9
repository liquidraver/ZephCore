## zephcore/boards/esp32/thinknode_m9/board.yml
```yaml
# Copyright (c) 2026 ZephCore
# SPDX-License-Identifier: MIT

board:
  name: thinknode_m9
  full_name: Elecrow ThinkNode M9 (ESP32-S3 + LR1110 + ST7789 TFT)
  vendor: elecrow
  socs:
    - name: esp32s3
```

## zephcore/boards/nrf52840/muziworks_r1neo/Kconfig.muziworks_r1neo
```kconfig
# Copyright (c) 2026 ZephCore
#
# SPDX-License-Identifier: MIT

config BOARD_MUZIWORKS_R1NEO
	select SOC_NRF52840_QIAA
```

## zephcore/boards/nrf52840/muziworks_r1neo/board.yml
```yaml
# Copyright (c) 2026 ZephCore
#
# SPDX-License-Identifier: MIT

board:
  name: muziworks_r1neo
  full_name: muzi works R1 Neo
  vendor: muziworks
  socs:
    - name: nrf52840
```

## zephcore/boards/nrf52840/wio_tracker_l1_epaper/board.yml
```yaml
# Copyright (c) 2025 MeshCore
#
# SPDX-License-Identifier: Apache-2.0

board:
  name: wio_tracker_l1_epaper
  full_name: Seeed Wio Tracker L1 (SSD1680 ePaper)
  vendor: seeed
  socs:
  - name: nrf52840
```

## zephcore/boards/nrf52840/wio_tracker_l1_epaper/wio_tracker_l1_epaper_nrf52840_defconfig
```kconfig
CONFIG_SOC_SERIES_NRF52X=y
CONFIG_SOC_NRF52840_QIAA=y
CONFIG_BOARD_WIO_TRACKER_L1_EPAPER=y

CONFIG_CONSOLE=y
CONFIG_UART_CONSOLE=y
CONFIG_SERIAL=y
CONFIG_GPIO=y
CONFIG_PINCTRL=y
```

## zephcore/boards/nrf54l/seeed_lr2021_evk_lm20a/board.yml
```yaml
# Copyright (c) 2026 ZephCore
# SPDX-License-Identifier: MIT

board:
  name: seeed_lr2021_evk_lm20a
  full_name: Semtech LR2021 LoRa Plus EVK (XIAO nRF54LM20A + Wio-LR2021)
  vendor: seeed
  socs:
    - name: nrf54lm20a
```

## zephcore/patches/zephyr-new/dts/bindings/lora/semtech,lr1110.yaml
```yaml
# Copyright (c) 2025 ZephCore
# SPDX-License-Identifier: MIT

description: |
  Semtech LR1110 LoRa transceiver, ZephCore driver (drivers/lora/lr11xx).
  Property names follow upstream's semtech,lr11xx-base.yaml, so a board file
  carries over unchanged if the driver is ever swapped for upstream's.
  Base properties this driver does not implement are blocked, so setting one
  is a build error instead of a silent no-op. pa-hp-sel and pa-duty-cycle are
  ZephCore additions.

compatible: "semtech,lr1110"

include:
  - name: semtech,lr11xx-base.yaml
    property-blocklist:
      - lf-clk
      - use-dcdc
      - force-ldro
      - rfsw-tx-hf
      - rfsw-wifi

properties:
  reset-gpios:
    required: true

  busy-gpios:
    required: true

  irq-gpios:
    required: true

  pa-hp-sel:
    type: int
    default: 7
    description: PA HP selection (0-7). 7 = max power for HP PA.

  pa-duty-cycle:
    type: int
    default: 4
    description: PA duty cycle (0-7). Controls PA output power curve.
```
