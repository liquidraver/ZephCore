## zephcore/boards/nrf52840/ikoka_stick_30dbm/Kconfig.ikoka_stick_30dbm
```kconfig
# Ikoka Stick 30dBm board configuration
# DC/DC converter enabled via DTS: &reg1 { regulator-initial-mode = <NRF5X_REG_MODE_DCDC>; }

config BOARD_IKOKA_STICK_30DBM
	select SOC_NRF52840_QIAA
```

## zephcore/boards/nrf52840/ikoka_stick_30dbm/board.yml
```yaml
board:
  name: ikoka_stick_30dbm
  full_name: Ikoka Stick 30dBm (XIAO nRF52840 + E22-900M30S)
  vendor: ikoka
  socs:
    - name: nrf52840
```

## zephcore/boards/nrf52840/ikoka_stick_33dbm/board.yml
```yaml
board:
  name: ikoka_stick_33dbm
  full_name: Ikoka Stick 33dBm (XIAO nRF52840 + E22-900M33S)
  vendor: ikoka
  socs:
    - name: nrf52840
```

## zephcore/boards/nrf52840/lilygo_techo/Kconfig.lilygo_techo
```kconfig
# LilyGo T-Echo board configuration
# Copyright (c) 2026 ZephCore
# SPDX-License-Identifier: Apache-2.0

config BOARD_LILYGO_TECHO
	select SOC_NRF52840_QIAA

# Board power enable (P0.12) + LoRa power enable (P1.05) must go HIGH
# before the SX1262 and QSPI flash respond. QSPI NOR init priority is 41 —
# the fixed regulators that drive these rails have to run first.
if REGULATOR_FIXED
config REGULATOR_FIXED_INIT_PRIORITY
	default 30
endif
```

## zephcore/boards/nrf52840/lilygo_techo/board.yml
```yaml
# Copyright (c) 2026 ZephCore
# SPDX-License-Identifier: Apache-2.0

board:
  name: lilygo_techo
  full_name: LilyGo T-Echo (nRF52840 + SX1262 + SSD1681 EPD + L76K GPS)
  vendor: lilygo
  socs:
    - name: nrf52840
```

## zephcore/boards/nrf52840/lilygo_techo/lilygo_techo_defconfig
```kconfig
# SPDX-License-Identifier: Apache-2.0
# LilyGo T-Echo default configuration

# Enable MPU
CONFIG_ARM_MPU=y
CONFIG_HW_STACK_PROTECTION=y

# Enable GPIO
CONFIG_GPIO=y

# Enable console on USB CDC
CONFIG_CONSOLE=y
CONFIG_UART_CONSOLE=y
CONFIG_SERIAL=y
CONFIG_UART_LINE_CTRL=y

# Enable flash/NVS storage
CONFIG_FLASH=y
CONFIG_FLASH_MAP=y
CONFIG_NVS=y

# Pinctrl
CONFIG_PINCTRL=y

# SPI for LoRa + EPD display
CONFIG_SPI=y

# ADC for battery
CONFIG_ADC=y
```

## zephcore/boards/nrf52840/lilygo_timpulse_plus/Kconfig.lilygo_timpulse_plus
```kconfig
# LilyGo T-Impulse Plus board configuration
# Copyright (c) 2026 ZephCore
# SPDX-License-Identifier: MIT

config BOARD_LILYGO_TIMPULSE_PLUS
	select SOC_NRF52840_QIAA

# The RT9080 LDO (P0.14) gates the whole 3V3 peripheral rail — SX1262, the
# SSD1315 OLED, the GPS and the QSPI flash all sit behind it. The fixed
# regulator that drives it (pwr_enable) must come up before those devices
# initialise. QSPI NOR init priority is 41, so pin the regulator ahead of it.
if REGULATOR_FIXED
config REGULATOR_FIXED_INIT_PRIORITY
	default 30
endif
```

## zephcore/boards/nrf52840/lilygo_timpulse_plus/board.yml
```yaml
# Copyright (c) 2026 ZephCore
# SPDX-License-Identifier: MIT

board:
  name: lilygo_timpulse_plus
  full_name: LilyGo T-Impulse Plus (nRF52840 + SX1262 + SSD1315 OLED + M10 GPS)
  vendor: lilygo
  socs:
    - name: nrf52840
```

## zephcore/boards/nrf52840/promicro_lr2021/Kconfig.promicro_lr2021
```kconfig
# ProMicro LR2021 board configuration
# Copyright (c) 2025 ZephCore
# SPDX-License-Identifier: MIT

config BOARD_PROMICRO_LR2021
	select SOC_NRF52840_QIAA
```

## zephcore/boards/nrf52840/promicro_lr2021/board.yml
```yaml
# Copyright (c) 2025 ZephCore
# SPDX-License-Identifier: MIT
board:
  name: promicro_lr2021
  full_name: ProMicro LR2021 (nRF52840 SuperMini + LR2021)
  vendor: zephcore
  socs:
    - name: nrf52840
```

## zephcore/boards/nrf52840/promicro_sx1262/Kconfig.promicro_sx1262
```kconfig
# ProMicro SX1262 (Ebyte E22-900M30S) board configuration
# Copyright (c) 2025 ZephCore
# SPDX-License-Identifier: MIT

config BOARD_PROMICRO_SX1262
	select SOC_NRF52840_QIAA
```

## zephcore/boards/nrf52840/promicro_sx1262/board.yml
```yaml
# Copyright (c) 2025 ZephCore
# SPDX-License-Identifier: MIT
board:
  name: promicro_sx1262
  full_name: ProMicro sx1262 (nRF52840 SuperMini + sx1262)
  vendor: zephcore
  socs:
    - name: nrf52840
```

## zephcore/boards/nrf52840/promicro_sx1262/promicro_sx1262_defconfig
```kconfig
# SPDX-License-Identifier: MIT
CONFIG_ARM_MPU=y
CONFIG_HW_STACK_PROTECTION=y
CONFIG_GPIO=y
CONFIG_CONSOLE=y
CONFIG_UART_CONSOLE=y
CONFIG_SERIAL=y
CONFIG_UART_LINE_CTRL=y
CONFIG_FLASH=y
CONFIG_FLASH_MAP=y
CONFIG_NVS=y
CONFIG_PINCTRL=y
CONFIG_SPI=y
CONFIG_ADC=y
```

## zephcore/boards/nrf52840/rak3401_1watt/Kconfig.rak3401_1watt
```kconfig
# RAK3401 1W board configuration
# Copyright (c) 2025 ZephCore
# SPDX-License-Identifier: MIT

config BOARD_RAK3401_1WATT
	select SOC_NRF52840_QIAA
```

## zephcore/boards/nrf52840/rak3401_1watt/board.yml
```yaml
board:
  name: rak3401_1watt
  full_name: RAK3401 1W (nRF52840 + SX1262 + SKY66122 PA)
  vendor: rakwireless
  socs:
    - name: nrf52840
```

## zephcore/boards/nrf52840/rak_wismesh_tag/Kconfig.rak_wismesh_tag
```kconfig
# RAK WisMesh Tag board configuration
# Copyright (c) 2025 ZephCore
# SPDX-License-Identifier: MIT

config BOARD_RAK_WISMESH_TAG
	select SOC_NRF52840_QIAA
```

## zephcore/boards/nrf52840/rak_wismesh_tag/board.yml
```yaml
# Copyright (c) 2025 ZephCore
# SPDX-License-Identifier: MIT

board:
  name: rak_wismesh_tag
  full_name: RAK WisMesh Tag (nRF52840 + SX1262 GPS Tracker)
  vendor: rak
  socs:
    - name: nrf52840
```

## zephcore/boards/nrf52840/sensecap_solar/Kconfig.sensecap_solar
```kconfig
# Copyright (c) 2025 ZephCore
# SPDX-License-Identifier: MIT

config BOARD_SENSECAP_SOLAR
	select SOC_NRF52840_QIAA
```

## zephcore/boards/nrf52840/sensecap_solar/board.yml
```yaml
# Copyright (c) 2025 ZephCore
# SPDX-License-Identifier: MIT

board:
  name: sensecap_solar
  full_name: Seeed SenseCAP Solar Node (P1 / P1-Pro)
  vendor: seeed
  socs:
  - name: nrf52840
```

## zephcore/boards/nrf52840/sensecap_solar/sensecap_solar_nrf52840_defconfig
```kconfig
# Copyright (c) 2025 ZephCore
# SPDX-License-Identifier: Apache-2.0

CONFIG_ARM_MPU=y
CONFIG_HW_STACK_PROTECTION=y
CONFIG_GPIO=y
CONFIG_SERIAL=y
CONFIG_CONSOLE=y
CONFIG_BUILD_OUTPUT_UF2=y
CONFIG_USE_DT_CODE_PARTITION=y
```

## zephcore/boards/nrf52840/t1000_e/Kconfig.t1000_e
```kconfig
# Copyright (c) 2025 MeshCore
#
# SPDX-License-Identifier: MIT

config BOARD_T1000_E
	select SOC_NRF52840_QIAA
```

## zephcore/boards/nrf52840/t1000_e/board.yml
```yaml
# Copyright (c) 2025 MeshCore
#
# SPDX-License-Identifier: MIT

board:
  name: t1000_e
  full_name: Seeed Tracker T1000-E
  vendor: seeed
  socs:
  - name: nrf52840
```

## zephcore/boards/nrf52840/thinknode_m1/Kconfig.thinknode_m1
```kconfig
# Elecrow ThinkNode M1 board configuration
# Copyright (c) 2025 ZephCore
# SPDX-License-Identifier: MIT

config BOARD_THINKNODE_M1
	select SOC_NRF52840_QIAA

# Board power enable (P0.12) must be HIGH before QSPI flash can respond.
# QSPI NOR init priority is 41 — regulator must run first.
if REGULATOR_FIXED
config REGULATOR_FIXED_INIT_PRIORITY
	default 30
endif
```

## zephcore/boards/nrf52840/thinknode_m1/board.yml
```yaml
# Copyright (c) 2025 ZephCore
# SPDX-License-Identifier: MIT

board:
  name: thinknode_m1
  full_name: Elecrow ThinkNode M1 (nRF52840 + SX1262 + SSD1681 EPD)
  vendor: elecrow
  socs:
    - name: nrf52840
```

## zephcore/boards/nrf52840/thinknode_m3/Kconfig.thinknode_m3
```kconfig
# Copyright (c) 2025 ZephCore
#
# SPDX-License-Identifier: MIT

config BOARD_THINKNODE_M3
	select SOC_NRF52840_QIAA
```
