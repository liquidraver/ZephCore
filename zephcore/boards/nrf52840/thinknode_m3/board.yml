## zephcore/boards/nrf52840/thinknode_m3/board.yml
```yaml
# Copyright (c) 2025 ZephCore
#
# SPDX-License-Identifier: MIT

board:
  name: thinknode_m3
  full_name: Elecrow ThinkNode M3 (nRF52840 + LR1110)
  vendor: elecrow
  socs:
  - name: nrf52840
```

## zephcore/boards/nrf52840/thinknode_m6/Kconfig.thinknode_m6
```kconfig
# Copyright (c) 2025 ZephCore
#
# SPDX-License-Identifier: MIT

config BOARD_THINKNODE_M6
	select SOC_NRF52840_QIAA
```

## zephcore/boards/nrf52840/thinknode_m6/board.yml
```yaml
# Copyright (c) 2025 ZephCore
#
# SPDX-License-Identifier: MIT

board:
  name: thinknode_m6
  full_name: Elecrow ThinkNode M6 (nRF52840 + SX1262)
  vendor: elecrow
  socs:
  - name: nrf52840
```

## zephcore/boards/nrf52840/wio_tracker_l1/Kconfig.wio_tracker_l1
```kconfig
# Copyright (c) 2025 MeshCore
#
# SPDX-License-Identifier: MIT

config BOARD_WIO_TRACKER_L1
	select SOC_NRF52840_QIAA
	select ZEPHCORE_UI_JOYSTICK
```

## zephcore/boards/nrf52840/wio_tracker_l1/board.yml
```yaml
# Copyright (c) 2025 MeshCore
#
# SPDX-License-Identifier: MIT

board:
  name: wio_tracker_l1
  full_name: Seeed Wio Tracker L1
  vendor: seeed
  socs:
  - name: nrf52840
```

## zephcore/boards/nrf52840/xiao_nrf52840/Kconfig.xiao_nrf52840
```kconfig
# Copyright (c) 2025 ZephCore
# SPDX-License-Identifier: MIT

config BOARD_XIAO_NRF52840
	select SOC_NRF52840_QIAA
```

## zephcore/boards/nrf52840/xiao_nrf52840/board.yml
```yaml
# Copyright (c) 2025 ZephCore
# SPDX-License-Identifier: MIT

board:
  name: xiao_nrf52840
  full_name: Seeed XIAO nRF52840 (Wio-SX1262)
  vendor: seeed
  socs:
  - name: nrf52840
```

## zephcore/patches/zephyr-new/drivers/gpio/Kconfig.native_linux
```kconfig
# Copyright (c) 2026 ZephCore
# SPDX-License-Identifier: MIT

config GPIO_NATIVE_LINUX
	bool "ZephCore native Linux GPIO driver (kernel V2 chardev)"
	default y
	depends on DT_HAS_ZEPHCORE_GPIO_NATIVE_LINUX_ENABLED
	depends on ARCH_POSIX
	help
	  Enables the gpio_native_linux driver, which bridges Zephyr GPIO
	  calls to a Linux /dev/gpiochipX character device via the kernel's
	  GPIO V2 chardev uAPI (ioctl on /dev/gpiochipN). Used by native_sim
	  builds running on real Linux SBCs.

	  No userspace library dependency — uses kernel ioctls directly.
	  Requires Linux >= 5.10 (GPIO V2 uAPI, released Dec 2020).

	  GPIO chip device path and line offsets are configured via DT,
	  with optional runtime override via --lora-gpio-chip=<path>.
```

## zephcore/patches/zephyr-new/drivers/lora/lr11xx/Kconfig
```kconfig
# Copyright (c) 2025 MeshCore
# SPDX-License-Identifier: MIT

config LORA_LR11XX
	bool "Semtech LR11xx LoRa transceiver driver"
	default y
	depends on DT_HAS_SEMTECH_LR1110_ENABLED
	select SPI
	select GPIO
	help
	  Enable driver for Semtech LR1110/LR1120/LR1121 LoRa transceivers.
	  Uses native Semtech lr11xx_driver SDK with Zephyr LoRa driver API.
```

## zephcore/patches/zephyr-new/drivers/lora/lr20xx/Kconfig
```kconfig
# Copyright (c) 2025 ZephCore
# SPDX-License-Identifier: MIT

config LORA_LR20XX
	bool "Semtech LR20xx LoRa transceiver driver"
	default y
	depends on DT_HAS_SEMTECH_LR2021_ENABLED
	select SPI
	select GPIO
	help
	  Enable driver for Semtech LR2021 (LoRa Plus, 4th-gen) transceivers.
	  Uses native Semtech lr20xx_driver SDK with Zephyr LoRa driver API.
	  Supports sub-GHz + 2.4 GHz ISM + NTN/SATCOM.
```

## zephcore/patches/zephyr-new/drivers/spi/Kconfig.native_linux
```kconfig
# Copyright (c) 2026 ZephCore
# SPDX-License-Identifier: MIT

config SPI_NATIVE_LINUX
	bool "ZephCore native Linux SPI driver (spidev)"
	default y
	depends on DT_HAS_ZEPHCORE_SPI_NATIVE_LINUX_ENABLED
	depends on ARCH_POSIX
	help
	  Enables the spi_native_linux driver, which forwards Zephyr SPI
	  transceive calls to a Linux /dev/spidevX.Y character device via
	  SPI_IOC_MESSAGE ioctl. Used by native_sim builds running on real
	  Linux SBCs (Femtofox, Raspberry Pi, etc.) that have a LoRa radio
	  wired up to a hardware SPI bus.
```

## zephcore/patches/zephyr-new/dts/bindings/gpio/zephcore,gpio-native-linux.yaml
```yaml
# Copyright (c) 2026 ZephCore
# SPDX-License-Identifier: MIT

description: |
  ZephCore GPIO controller using Linux libgpiod v2.

  Bridges Zephyr's GPIO subsystem to a Linux /dev/gpiochipX character
  device via libgpiod v2 (gpiod_line_request_*). Used by native_sim
  builds running on real Linux SBCs.

  The host gpiochip path defaults to the DT property below, but can be
  overridden at runtime with the --lora-gpio-chip=<path> command-line
  argument.

compatible: "zephcore,gpio-native-linux"

include: [gpio-controller.yaml, base.yaml]

properties:
  gpio-chip:
    type: string
    required: true
    description: |
      Linux gpiochip character device path, e.g. "/dev/gpiochip0".
      Overridable at runtime via --lora-gpio-chip=<path>.

  ngpios:
    type: int
    required: true
    description: |
      Number of pins exposed by this controller. The actual number of
      lines on the host gpiochip can be larger; we just cap our pin
      space here. Should be at least 32 for typical SX126x setups.

  "#gpio-cells":
    const: 2

gpio-cells:
  - pin
  - flags
```

## zephcore/patches/zephyr-new/dts/bindings/spi/zephcore,spi-native-linux.yaml
```yaml
# Copyright (c) 2026 ZephCore
# SPDX-License-Identifier: MIT

description: |
  ZephCore SPI driver using Linux spidev.

  Bridges Zephyr's SPI subsystem to a Linux /dev/spidevX.Y character device
  via SPI_IOC_MESSAGE ioctl. CS is driven via the linked GPIO controller
  (spi-cs-gpios), not by spidev's hardware CS, so the SX126x driver's
  software CS sequencing keeps working unchanged.

  The host SPI device path defaults to the DT property below, but can be
  overridden at runtime with the --lora-spidev=<path> command-line argument.

compatible: "zephcore,spi-native-linux"

include: [spi-controller.yaml]

properties:
  spi-dev:
    type: string
    required: true
    description: |
      Linux host SPI character device path, e.g. "/dev/spidev0.0".
      Overridable at runtime via --lora-spidev=<path>.

  spi-mode:
    type: int
    default: 0
    description: |
      SPI mode byte passed to SPI_IOC_WR_MODE (0..3).
      0 = CPOL=0/CPHA=0 (SX126x default).
```

## zephcore/patches/zephyr/drivers/gnss/Kconfig.luatos_air530z
```kconfig
# Copyright 2024 Jerónimo Agulló
# SPDX-License-Identifier: Apache-2.0

config GNSS_LUATOS_AIR530Z
	bool "Luatos Air530z GNSS device"
	default y
	depends on GNSS
	depends on DT_HAS_LUATOS_AIR530Z_ENABLED
	depends on GNSS_REFERENCE_FRAME_WGS84
	select MODEM_MODULES
	select MODEM_BACKEND_UART
	select MODEM_CHAT
	select GNSS_PARSE
	select GNSS_NMEA0183
	select GNSS_NMEA0183_MATCH
	help
	  Enable Luatos Air530z GNSS driver.

if GNSS_LUATOS_AIR530Z

config GNSS_LUATOS_AIR530Z_SATELLITES_COUNT
	int "Maximum satellite count"
	depends on GNSS_SATELLITES
	default 24
	help
	  Maximum number of satellites that can be decoded from the
	  GNSS device. This does not affect the number of devices that
	  the device is actually tracking, just how many of those can
	  be reported in the satellites callback.

config GNSS_LUATOS_AIR530Z_EASY
	bool "Enable EASY (Embedded Assist System) for faster TTFF"
	default y
	help
	  Enable MediaTek EASY (Embedded Assist System) mode via PMTK869
	  command. EASY caches predicted ephemeris in the GNSS module's
	  internal flash, reducing Time-To-First-Fix from 15-45s (cold)
	  to 1-3s (warm). Sent on every driver init (boot and PM resume).
	  The setting persists in GNSS flash, so resending is a no-op.
	  Compatible with L76K/L76KB and other MediaTek-based GNSS chips
	  that accept PMTK commands alongside PCAS.

endif
```
