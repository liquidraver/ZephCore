/*
 * Common LittleFS filesystem configuration for ZephCore boards.
 * Include this in board overlays to get standard /lfs mount.
 *
 * Requires board to define: &lfs_partition
 *
 * SPDX-License-Identifier: MIT
 */

/ {
	fstab {
		compatible = "zephyr,fstab";

		/* Internal LittleFS for identity, prefs */
		lfs: lfs {
			compatible = "zephyr,fstab,littlefs";
			mount-point = "/lfs";
			partition = <&lfs_partition>;
			automount;
			read-size = <16>;
			prog-size = <16>;
			cache-size = <64>;
			lookahead-size = <32>;
			block-cycles = <512>;
		};
	};
};
