/*
 * SPDX-License-Identifier: MIT
 * QSPI external flash /ext automount — optional add-on for any platform
 *
 * See nrf52_partitions_sdv7.dtsi for full include guide.
 *
 * When /ext is available, ZephyrDataStore redirects contacts, channels,
 * and blobs to QSPI flash (more space, faster writes on native 4KB blocks).
 * Prefs and identity stay on internal flash.
 *
 * Requires board DTS to define: qspi_storage_partition
 *
 * Usage in board overlay (in addition to partition or filesystem include):
 *   #include "../../common/qspi-ext.dtsi"
 *
 * Works with all platforms using /lfs mount.
 */

/ {
	fstab {
		/* External QSPI for contacts, channels, blobs */
		qspi_lfs: qspi_lfs {
			compatible = "zephyr,fstab,littlefs";
			mount-point = "/ext";
			partition = <&qspi_storage_partition>;
			automount;
			read-size = <16>;
			prog-size = <16>;
			cache-size = <64>;
			lookahead-size = <32>;
			block-cycles = <512>;
		};
	};
};
